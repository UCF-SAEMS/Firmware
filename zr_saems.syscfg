/**
 * @cliArgs --board "/ti/boards/CC1352P_2_LAUNCHXL" --product "simplelink_cc13x2_26x2_sdk@4.40.04.04"
 * @versions {"data":"2021010520","timestamp":"2021010520","tool":"1.7.0+1746","templates":null}
 */

/**
 * Import the modules used in this configuration.
 */
const CCFG     = scripting.addModule("/ti/devices/CCFG");
const rfdesign = scripting.addModule("/ti/devices/radioconfig/rfdesign");
const Display  = scripting.addModule("/ti/display/Display", {}, false);
const Display1 = Display.addInstance();
const ADC      = scripting.addModule("/ti/drivers/ADC", {}, false);
const ADC1     = ADC.addInstance();
const AESCBC   = scripting.addModule("/ti/drivers/AESCBC");
const AESCBC1  = AESCBC.addInstance();
const AESCCM   = scripting.addModule("/ti/drivers/AESCCM");
const AESCCM1  = AESCCM.addInstance();
const AESECB   = scripting.addModule("/ti/drivers/AESECB");
const AESECB1  = AESECB.addInstance();
const DMA      = scripting.addModule("/ti/drivers/DMA");
const ECDH     = scripting.addModule("/ti/drivers/ECDH");
const ECDH1    = ECDH.addInstance();
const ECDSA    = scripting.addModule("/ti/drivers/ECDSA");
const ECDSA1   = ECDSA.addInstance();
const ECJPAKE  = scripting.addModule("/ti/drivers/ECJPAKE");
const ECJPAKE1 = ECJPAKE.addInstance();
const GPIO     = scripting.addModule("/ti/drivers/GPIO", {}, false);
const GPIO1    = GPIO.addInstance();
const I2C      = scripting.addModule("/ti/drivers/I2C", {}, false);
const I2C1     = I2C.addInstance();
const NVS      = scripting.addModule("/ti/drivers/NVS");
const NVS1     = NVS.addInstance();
const PWM      = scripting.addModule("/ti/drivers/PWM", {}, false);
const PWM1     = PWM.addInstance();
const Power    = scripting.addModule("/ti/drivers/Power");
const RF       = scripting.addModule("/ti/drivers/RF");
const SHA2     = scripting.addModule("/ti/drivers/SHA2");
const SHA21    = SHA2.addInstance();
const SPI      = scripting.addModule("/ti/drivers/SPI", {}, false);
const SPI1     = SPI.addInstance();
const TRNG     = scripting.addModule("/ti/drivers/TRNG");
const TRNG1    = TRNG.addInstance();
const zstack   = scripting.addModule("/ti/zstack/zstack");

/**
 * Write custom configuration values to the imported modules.
 */
CCFG.xoscCapArray             = true;
CCFG.xoscCapArrayDelta        = 0xC1;
CCFG.enableBootloader         = true;
CCFG.enableBootloaderBackdoor = true;
CCFG.dioBootloaderBackdoor    = 15;
CCFG.forceVddr                = true;
CCFG.ccfgTemplate.$name       = "ti_devices_CCFGTemplate0";

rfdesign.rfDesign = "LAUNCHXL-CC1352P-2";

Display1.$name                    = "CONFIG_Display_0";
Display1.enableANSI               = true;
Display1.uart.$name               = "CONFIG_DISPLAY_UART_MINE";
Display1.uart.uart.txPin.$assign  = "boosterpack.3";
Display1.uart.uart.rxPin.$assign  = "boosterpack.4";
Display1.uart.txPinInstance.$name = "CONFIG_PIN_5";
Display1.uart.rxPinInstance.$name = "CONFIG_PIN_6";
scripting.suppress("Connected to hardware,@@@.+?@@@ is connected to XDS110 UART on the CC1352P-2 LaunchPad\. Consider selecting it in 'use hardware' above\. @@@.+?@@@",Display1.uart.uart.txPin);
scripting.suppress("Connected to hardware,@@@.+?@@@ is connected to XDS110 UART on the CC1352P-2 LaunchPad\. Consider selecting it in 'use hardware' above\. @@@.+?@@@",Display1.uart.uart.rxPin);

ADC1.$name                = "CO_OUT";
ADC1.adjustSampleValue    = true;
ADC1.samplingDuration     = "85.3 us";
ADC1.adc.$assign          = "ADC0";
ADC1.adc.adcPin.$assign   = "boosterpack.2";
ADC1.adcPinInstance.$name = "CONFIG_PIN_7";

AESCBC1.$name = "CONFIG_AESCBC_0";

AESCCM1.$name             = "CONFIG_AESCCM_0";
AESCCM1.interruptPriority = "2";

AESECB1.$name             = "CONFIG_AESECB_0";
AESECB1.interruptPriority = "1";

ECDH1.$name = "CONFIG_ECDH_0";

ECDSA1.$name = "CONFIG_ECDSA_0";

ECJPAKE1.$name = "CONFIG_ECJPAKE_0";

GPIO1.$name             = "PIR_SENSOR";
GPIO1.pull              = "Pull Down";
GPIO1.interruptTrigger  = "Rising Edge";
GPIO1.gpioPin.$assign   = "boosterpack.25";
GPIO1.pinInstance.$name = "CONFIG_PIN_8";

I2C1.$name                = "CONFIG_I2C_0";
I2C1.i2c.sdaPin.$assign   = "boosterpack.10";
I2C1.i2c.sclPin.$assign   = "boosterpack.38";
I2C1.sdaPinInstance.$name = "CONFIG_PIN_1";
I2C1.clkPinInstance.$name = "CONFIG_PIN_2";
scripting.suppress("Connected to hardware,@@@.+?@@@ is connected to MX25R8035F SPI Flash Slave Select on the CC1352P-2 LaunchPad\. Consider selecting it in 'use hardware' above\. @@@.+?@@@",I2C1.i2c.sclPin);

NVS1.$name                    = "CONFIG_NVSINTERNAL";
NVS1.internalFlash.$name      = "ti_drivers_nvs_NVSCC26XX0";
NVS1.internalFlash.regionBase = 0x52000;
NVS1.internalFlash.regionSize = 0x4000;

PWM1.$name                            = "CONFIG_PWM_4KHZ";
PWM1.timerObject.$name                = "CONFIG_GPTIMER_0";
PWM1.timerObject.timer.pwmPin.$assign = "boosterpack.13";
PWM1.timerObject.pwmPinInstance.$name = "CONFIG_PIN_7";
scripting.suppress("Connected to hardware,@@@.+?@@@ is connected to LaunchPad Button BTN-1 \(Left\) on the CC1352P-2 LaunchPad\. Consider selecting it in 'use hardware' above\. @@@.+?@@@",PWM1.timerObject.timer.pwmPin);

RF.$hardware             = system.deviceData.board.components["SKY13317-373LF"];
RF.rfAntennaPin0.$assign = "41";
RF.rfAntennaPin1.$assign = "42";
RF.rfAntennaPin2.$assign = "43";

SHA21.$name = "CONFIG_SHA2_0";

SPI1.$name                 = "CONFIG_SPI_LEDBOARD";
SPI1.spi.sclkPin.$assign   = "boosterpack.7";
SPI1.spi.misoPin.$assign   = "boosterpack.14";
SPI1.spi.mosiPin.$assign   = "boosterpack.24";
SPI1.sclkPinInstance.$name = "CONFIG_PIN_0";
SPI1.misoPinInstance.$name = "CONFIG_PIN_3";
SPI1.mosiPinInstance.$name = "CONFIG_PIN_4";
SPI1.mosiPinInstance.mode  = "Input";
scripting.suppress("Connected to hardware,@@@.+?@@@ is connected to LaunchPad SPI Bus on the CC1352P-2 LaunchPad\. Consider selecting it in 'use hardware' above\. @@@.+?@@@",SPI1.spi.sclkPin);
scripting.suppress("Connected to hardware,@@@.+?@@@ is connected to LaunchPad SPI Bus on the CC1352P-2 LaunchPad\. Consider selecting it in 'use hardware' above\. @@@.+?@@@",SPI1.spi.misoPin);

TRNG1.$name = "CONFIG_TRNG_0";

zstack.deviceType                            = "zr";
zstack.deviceTypeReadOnly                    = true;
zstack.touchlink.$name                       = "ti_zstack_touchlink_zstack_touchlink0";
zstack.touchlink.touchlinkEnabled            = true;
zstack.pm.$name                              = "ti_zstack_pm_zstack_pm0";
zstack.rf.$name                              = "ti_zstack_rf_zstack_rf0";
zstack.rf.primaryChannels                    = [11,12,13,14,15,16,17,18,19,20,21,22,23,24,25,26];
zstack.rf.radioConfig.$name                  = "ti_devices_radioconfig_settings_ieee_15_40";
zstack.rf.radioConfig.codeExportConfig.$name = "ti_devices_radioconfig_code_export_param0";
zstack.network.$name                         = "ti_zstack_network_zstack_network0";
zstack.advanced.$name                        = "ti_zstack_advanced_zstack_advanced0";
zstack.advanced.routing.$name                = "ti_zstack_advanced_zstack_routing0";
zstack.advanced.packetSending.$name          = "ti_zstack_advanced_zstack_packet_sending0";
zstack.advanced.tableSize.$name              = "ti_zstack_advanced_zstack_table_size0";
zstack.advanced.tableSize.bindingTableSize   = 16;

/**
 * Pinmux solution for unlocked pins/peripherals. This ensures that minor changes to the automatic solver in a future
 * version of the tool will not impact the pinmux you originally saw.  These lines can be completely deleted in order to
 * re-solve from scratch.
 */
Display1.uart.uart.$suggestSolution    = "UART1";
I2C1.i2c.$suggestSolution              = "I2C0";
SPI1.spi.$suggestSolution              = "SSI0";
SPI1.spi.dmaRxChannel.$suggestSolution = "DMA_CH3";
SPI1.spi.dmaTxChannel.$suggestSolution = "DMA_CH4";
